## npz2100_module/boards/nanopower/npz2100dk/Kconfig.npz2100dk
```kconfig
# Copyright (c) Nanopower Semiconductor AS
# SPDX-License-Identifier: Apache-2.0

config BOARD_NPZ2100DK
	select SOC_NRF52833_QIAA
```

## npz2100_module/boards/shields/npz2100/Kconfig.shield
```kconfig
# Copyright (c) Nanopower Semiconductor AS
# SPDX-License-Identifier: Apache-2.0

config SHIELD_NPZ2100
	def_bool $(shields_list_contains,npz2100)
```
