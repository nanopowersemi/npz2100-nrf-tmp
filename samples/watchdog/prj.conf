## CMakeLists.txt
```
# Copyright (c) Nanopower Semiconductor AS
# SPDX-License-Identifier: Apache-2.0
#
# samples/watchdog/CMakeLists.txt
# -------------------------------
# CMake entry point for the nPZ2100 watchdog sample: the host wakes every
# 3 seconds and kicks the nPZ2100 watchdog, then simulates a hang that the
# watchdog resets after about 6 seconds.
# Target: nRF5x / NCS 3.3.4 / VS Code nRF Connect extension.
#
# The nPZ2100 Zephyr module (npz2100_module/) is referenced via
# ZEPHYR_EXTRA_MODULES so no west.yml changes are required for evaluation.
#
# Building from the VS Code nRF Connect extension:
#   1. Open the samples/watchdog/ folder as the application.
#   2. Add build configuration → board: e.g. nrf52840dk/nrf52840.
#   3. The lines below add the module and the npz2100 shield automatically.
#
# Building from the terminal:
#   west build -b nrf52840dk/nrf52840 samples/watchdog/

cmake_minimum_required(VERSION 3.20)

# ---- Register the nPZ2100 module ----------------------------------------
#
# The path below is relative to this CMakeLists.txt and assumes the layout:
#
#   npz2100_ncs/
#   ├── npz2100_module/            ← Zephyr module (driver, headers, bindings)
#   └── samples/
#       └── watchdog/              ← This application (open this in VS Code)
#
# If you move npz2100_module/ elsewhere, update the path below to match.
list(APPEND ZEPHYR_EXTRA_MODULES
    ${CMAKE_CURRENT_SOURCE_DIR}/../../npz2100_module
)

# ---- Select the nPZero shield ---------------------------------------------
#
# Selected here rather than with --shield: sysbuild validates --shield
# before this file registers the module, so it would not find the shield.
list(APPEND SHIELD npz2100)

find_package(Zephyr REQUIRED HINTS $ENV{ZEPHYR_BASE})

project(npz2100_watchdog VERSION 1.0.0)

target_sources(app PRIVATE src/main.c)

# Shared sample helpers (sample_log_color.h).
target_include_directories(app PRIVATE ../common)
```

## sample.yaml
```
sample:
  name: nPZ2100 watchdog
  description: nPZ2100 watchdog resetting a hung host, with a 3 s time-out wake
common:
  tags: npz2100
  # Boards the npz2100 shield has board overlays for, plus the nPZ2100 DK
  # (npz2100_module/boards/nanopower/npz2100dk/).
  platform_allow:
    - nrf52dk/nrf52832
    - nrf52833dk/nrf52833
    - nrf52840dk/nrf52840
    - npz2100dk/nrf52833
  integration_platforms:
    - nrf52833dk/nrf52833
    - npz2100dk/nrf52833
  harness: console
  harness_config:
    type: multi_line
    ordered: true
    regex:
      - "nPZ2100 watchdog sample boot"
      - "Simulating a hang"
      - "Recovered from a watchdog reset"
tests:
  sample.npz2100.watchdog: {}
```

## prj.conf
```kconfig
# Copyright (c) Nanopower Semiconductor AS
# SPDX-License-Identifier: Apache-2.0
#
# samples/watchdog/prj.conf
# -------------------------
# Kconfig for the nPZ2100 watchdog sample on nRF5x / NCS 3.3.4.
#
# The npz2100 shield (selected in CMakeLists.txt) adds the nPZ2100
# devicetree node and enables the I²C subsystem by default.
#
# No GPIO or interrupt configuration is required.
# The nPZ2100 controls the nRF5x power supply directly via SW_HP.
# Every nRF5x boot is caused by the nPZ2100 re-enabling the host switch.

# nPZ2100 driver
CONFIG_NPZ2100=y
CONFIG_NPZ2100_INIT_PRIORITY=80

# Driver logging (0=OFF 1=ERR 2=WRN 3=INF 4=DBG)
CONFIG_LOG=y
CONFIG_NPZ2100_LOG_LEVEL_INF=y

# Colored log: errors red, warnings yellow, and the key events colored by
# main.c (samples/common/sample_log_color.h). Set to n for plain output.
CONFIG_LOG_BACKEND_SHOW_COLOR=y

CONFIG_USE_SEGGER_RTT=y
CONFIG_RTT_CONSOLE=y
CONFIG_LOG_BACKEND_RTT=y

CONFIG_CONSOLE=y
CONFIG_UART_CONSOLE=y
```

## src/main.c
```c
/*
 * Copyright (c) Nanopower Semiconductor AS
 * SPDX-License-Identifier: Apache-2.0
 *
 * samples/watchdog/src/main.c
 * ---------------------------
 * nPZ2100 watchdog sample for Nordic nRF5x platforms running NCS 3.3.4.
 *
 * What it does
 * ------------
 *   - The regmap enables the nPZ2100 watchdog (about 6 s) and a 3 s
 *     time-out wake (TOUT). Every boot reads STA1/STA2, which restarts the
 *     watchdog, so normal wakes never trigger it.
 *   - Start-up (a boot not caused by a time-out or the watchdog): the demo
 *     is armed.
 *   - First time-out wake after start-up: the demo is disarmed and the
 *     application simulates a hang — it logs once a second and never
 *     returns to idle. The watchdog resets the nPZ2100 about 6 s later,
 *     which power-cycles the nRF5x.
 *   - Watchdog reset boot: the reset is reported, and the 3 s wakes
 *     continue normally from then on.
 *
 * Power architecture
 * ------------------
 * The nPZ2100 controls the nRF5x power supply via SW_HP. When idle the
 * nPZ2100 cuts power to the nRF5x completely, so every boot of this
 * application is one wake cycle.
 *
 * Demo state
 * ----------
 * The nRF5x keeps no RAM across wakes, so whether the hang has already been
 * shown is kept in one byte of nPZ2100 SRAM (APP_SRAM_DEMO_ADDR). The
 * watchdog reset is a soft reset, which keeps the SRAM and the
 * configuration.
 */

#include <zephyr/kernel.h>
#include <zephyr/device.h>
#include <zephyr/devicetree.h>
#include <zephyr/logging/log.h>
#include <zephyr/logging/log_ctrl.h>

#include <drivers/npz2100.h>
#include "npz2100_regmap.h"
#include "sample_log_color.h"

LOG_MODULE_REGISTER(app, LOG_LEVEL_INF);

/** nPZ2100 SRAM byte holding the demo state. */
#define APP_SRAM_DEMO_ADDR  0x00u

/** Demo state: hang on the next time-out wake. Any other value: don't. */
#define APP_DEMO_ARMED      0xA5u
#define APP_DEMO_DONE       0x00u

/* -------------------------------------------------------------------------
 * Device handle - obtained from the DT node labelled "npz2100".
 * Defined by the npz2100 shield (npz2100_module/boards/shields/npz2100/).
 * ---------------------------------------------------------------------- */
static const struct device *const npz2100 =
	DEVICE_DT_GET(DT_NODELABEL(npz2100));

static int demo_state_set(uint8_t state)
{
	return npz2100_sram_write(npz2100, APP_SRAM_DEMO_ADDR, &state, 1u);
}

static int demo_state_get(uint8_t *state)
{
	return npz2100_sram_read(npz2100, APP_SRAM_DEMO_ADDR, state, 1u);
}

/* -------------------------------------------------------------------------
 * simulate_hang
 *
 * Stands in for application code that gets stuck. It never reads STA1/STA2
 * and never calls npz2100_enter_idle(), so the watchdog is not restarted
 * and the nPZ2100 resets the system once it expires.
 * ---------------------------------------------------------------------- */
static void simulate_hang(void)
{
	uint32_t seconds = 0u;

	LOG_WRN("Simulating a hang - waiting for the watchdog");

	while (true) {
		LOG_INF("Hung for %u s", seconds);
		k_msleep(1000);
		seconds++;
	}
}

/* -------------------------------------------------------------------------
 * main
 *
 * Executes once per nRF5x boot (= once per nPZ2100 wake cycle).
 * Does not contain a loop — the final call to npz2100_enter_idle() causes
 * the nPZ2100 to cut power to the nRF5x.
 * ---------------------------------------------------------------------- */
int main(void)
{
	int ret;
	npz2100_wake_reason_t reason;
	uint8_t state;

	LOG_INF_HL(SLC_CYAN, "--- nPZ2100 watchdog sample boot ---");

	if (!device_is_ready(npz2100)) {
		LOG_ERR("nPZ2100 device not ready");
		while (true) {
			k_msleep(1000);
		}
	}

	/* ------------------------------------------------------------------ */
	/* 1. Read wake-up reason.  MUST be the first nPZ2100 operation.      */
	/*    Reading STA1/STA2 also restarts the watchdog.                    */
	/* ------------------------------------------------------------------ */
	ret = npz2100_boot_status(npz2100, &reason);
	if (ret != 0) {
		LOG_ERR("boot_status failed: %d - cannot determine wake reason", ret);
		reason = (npz2100_wake_reason_t){ 0 };
	}

	/* ------------------------------------------------------------------ */
	/* 2. Sync shadow from device, so the regmap below only writes        */
	/*    registers that actually differ.                                  */
	/* ------------------------------------------------------------------ */
	ret = npz2100_readback(npz2100);
	if (ret != 0) {
		LOG_ERR("readback failed: %d", ret);
	}

	/* ------------------------------------------------------------------ */
	/* 3. Apply the static configuration: TOUT = 3 s, watchdog = 6 s.     */
	/* ------------------------------------------------------------------ */
	ret = npz2100_apply_regmap(npz2100, npz2100_regmap, sizeof(npz2100_regmap));
	if (ret != 0) {
		LOG_ERR("apply_regmap failed: %d", ret);
	}

	/* ------------------------------------------------------------------ */
	/* 4. Handle the wake reason.                                          */
	/* ------------------------------------------------------------------ */
	if (reason.timeout) {
		LOG_INF_HL(SLC_BLUE, "Time-out wake - watchdog restarted");

		ret = demo_state_get(&state);
		if (ret != 0) {
			LOG_ERR("Reading demo state failed: %d", ret);
		} else if (state == APP_DEMO_ARMED) {
			/* Disarm first, so the hang is shown only once. */
			ret = demo_state_set(APP_DEMO_DONE);
			if (ret != 0) {
				LOG_ERR("Writing demo state failed: %d", ret);
			} else {
				simulate_hang();
			}
		}
	} else if (reason.srst_src == NPZ2100_SRST_SRC_WDOG) {
		LOG_WRN("Recovered from a watchdog reset");
	} else {
		LOG_INF_HL(SLC_MAGENTA, "Start-up - hang on the next time-out wake");

		ret = demo_state_set(APP_DEMO_ARMED);
		if (ret != 0) {
			LOG_ERR("Writing demo state failed: %d", ret);
		}
	}

	/* ------------------------------------------------------------------ */
	/* 5. Re-enter idle.  nPZ2100 will cut nRF5x power.                   */
	/*    LOG_PANIC() flushes the deferred log buffer first so no output  */
	/*    is lost when power is cut.                                       */
	/* ------------------------------------------------------------------ */
	LOG_INF_HL(SLC_GRAY, "Returning to idle - next wake in 3 s");
	LOG_PANIC();

	ret = npz2100_enter_idle(npz2100);

	/*
	 * Reaching here means the I²C write to IDLE_RST failed.
	 */
	LOG_ERR("enter_idle failed: %d", ret);
	while (true) {
		k_msleep(1000);
	}

	return 0; /* unreachable */
}
```

## src/npz2100_regmap.h
```c
#ifndef __NPZ2100_REGMAP
#define __NPZ2100_REGMAP

// nPZ2100 Register Map — watchdog sample
//
// Wake the host every 3 seconds: TOUT_EXT = 0 selects 62.5 ms time-out
// steps, and TOUT = 48 gives 48 x 62.5 ms = 3 s.
//
// Watchdog: WDOG = 3 gives 3 x 2 s = 6 s, enabled by GTC_CFG.WDOGEN.
// Every boot reads STA1/STA2 in npz2100_boot_status(), which restarts the
// watchdog, so it only fires when the host stops booting normally.

static const unsigned char npz2100_regmap[] = {
  // ---- Global configuration registers ----
  10,         // Length
  0x05,       // Start address (IOCFG1 register)
  0x00, // IOCFG1 = 0x00
  0x00, // IOCFG2 = 0x00
  0xFF, // IOCFG3 = 0xFF
  0x00, // IOCFG4 = 0x00
  0x1D, // IOCFG5 = 0x1D
  0x00, // SYSCFG1 = 0x00 (no peripheral wake-up sources)
  0x00, // SYSCFG2 = 0x00 (TOUT_EXT = 0: 62.5ms time-out steps)
  0x30, 0x00, // (TOUT_L/TOUT_H) = 0x30 = 48 -> 3 s

  // ---- Watchdog ----
  4,          // Length
  0x19,       // Start address (WDOG_L register)
  0x03, 0x00, // (WDOG_L/WDOG_H) = 3 -> 6 s
  0x02, // GTC_CFG = 0x02 (WDOGEN = 1, alarm off)
};

#endif // __NPZ2100_REGMAP
```
