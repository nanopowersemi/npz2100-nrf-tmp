## CMakeLists.txt
```
# Copyright (c) Nanopower Semiconductor AS
# SPDX-License-Identifier: Apache-2.0
#
# samples/sensor_as6212/CMakeLists.txt
# ------------------------------------
# CMake entry point for the nPZ2100 DK AS6212 sample: the nPZ2100 polls the
# AS6212 temperature sensor on the DK and wakes the host when the reading
# crosses its thresholds, or on the periodic time-out.
# Target: npz2100dk/nrf52833 / NCS 3.3.4 / VS Code nRF Connect extension.
#
# Building from the terminal:
#   west build -b npz2100dk/nrf52833 samples/sensor_as6212/
#
# With MCUboot (single application slot, serial recovery over the DK's
# USB-UART), see README.md:
#   west build -b npz2100dk/nrf52833 samples/sensor_as6212/ \
#       -- -DSB_CONF_FILE=sysbuild-mcuboot.conf

cmake_minimum_required(VERSION 3.20)

# ---- Register the nPZ2100 module ----------------------------------------
#
# The path below is relative to this CMakeLists.txt and assumes the layout:
#
#   npz2100_ncs/
#   ├── npz2100_module/        ← Zephyr module (driver, headers, board)
#   └── samples/
#       └── sensor_as6212/     ← This application (open this in VS Code)
list(APPEND ZEPHYR_EXTRA_MODULES
    ${CMAKE_CURRENT_SOURCE_DIR}/../../npz2100_module
)

# ---- Select the nPZero shield ---------------------------------------------
#
# As in every sample. On the DK the shield overlay lands on the board's own
# nPZ2100 node (the DK labels I2C0 arduino_i2c), and it lets the sample
# build on the other boards too, where scripts/ci/build.py builds every
# sample. Selected here rather than with --shield: sysbuild validates
# --shield before this file registers the module.
list(APPEND SHIELD npz2100)

find_package(Zephyr REQUIRED HINTS $ENV{ZEPHYR_BASE})

project(npz2100_sensor_as6212 VERSION 1.0.0)

target_sources(app PRIVATE src/main.c)

# Shared sample helpers (sample_log_color.h).
target_include_directories(app PRIVATE ../common)
```

## sample.yaml
```
sample:
  name: nPZ2100 DK AS6212 sensor sample
  description: AS6212 on the nPZ2100 DK polled by the nPZ2100, threshold wake-up and time-out
common:
  tags: npz2100
  # The AS6212 is on the nPZ2100 DK, so this sample only runs there.
  platform_allow:
    - npz2100dk/nrf52833
  integration_platforms:
    - npz2100dk/nrf52833
  harness: console
  harness_config:
    type: multi_line
    ordered: true
    regex:
      - "nPZ2100 AS6212 sample boot"
      - "Returning to idle"
tests:
  sample.npz2100.sensor_as6212: {}
  # The same sample with MCUboot (single slot, serial recovery).
  sample.npz2100.sensor_as6212.mcuboot:
    extra_args:
      - SB_CONF_FILE=sysbuild-mcuboot.conf
```

## prj.conf
```kconfig
# Copyright (c) Nanopower Semiconductor AS
# SPDX-License-Identifier: Apache-2.0
#
# samples/sensor_as6212/prj.conf
# ------------------------------
# Kconfig for the nPZ2100 DK AS6212 sample / NCS 3.3.4.
#
# The npz2100dk board defines the nPZ2100 devicetree node on i2c0, and the
# npz2100 shield (selected in CMakeLists.txt) adds it on other boards.
# The nPZ2100 controls the nRF52833 power supply directly via SW_HP, so
# every boot is caused by the nPZ2100 re-enabling the host switch.

# nPZ2100 driver
CONFIG_NPZ2100=y
CONFIG_NPZ2100_INIT_PRIORITY=80

# Status LED
CONFIG_GPIO=y

# Driver logging (0=OFF 1=ERR 2=WRN 3=INF 4=DBG)
CONFIG_LOG=y
CONFIG_NPZ2100_LOG_LEVEL_INF=y

# Colored log: errors red, warnings yellow, and the key events colored by
# main.c (samples/common/sample_log_color.h). Set to n for plain output.
CONFIG_LOG_BACKEND_SHOW_COLOR=y

# Console on the DK's USB-UART (FT231X), as set by the board.
CONFIG_CONSOLE=y
CONFIG_UART_CONSOLE=y

# Register dump, for bench work: set APP_DUMP_REGISTERS in src/main.c too.
# CONFIG_NPZ2100_DUMP=y
```

## sysbuild-mcuboot.conf
```kconfig
# Copyright (c) Nanopower Semiconductor AS
# SPDX-License-Identifier: Apache-2.0
#
# samples/sensor_as6212/sysbuild-mcuboot.conf
# -------------------------------------------
# Optional sysbuild configuration: builds MCUboot together with the
# application. Select it with
#   west build -b npz2100dk/nrf52833 samples/sensor_as6212/ \
#       -- -DSB_CONF_FILE=sysbuild-mcuboot.conf
# Without it, the sample builds without a bootloader. MCUboot's own
# settings are in sysbuild/mcuboot.conf, which sysbuild only uses when
# MCUboot is built.

SB_CONFIG_BOOTLOADER_MCUBOOT=y

# Single application slot: serial recovery writes the new image straight
# into the primary slot, which leaves the most flash for the application.
SB_CONFIG_MCUBOOT_MODE_SINGLE_APP=y

# Images are signed with MCUboot's public development key, which NCS uses
# when no key file is given (the build prints a warning saying so). That
# key is public: anyone can sign an image for a board running this MCUboot.
# For a product, generate your own key and point to it:
#   SB_CONFIG_BOOT_SIGNATURE_TYPE_ECDSA_P256=y
#   SB_CONFIG_BOOT_SIGNATURE_KEY_FILE="\${APP_DIR}/keys/<your-key>.pem"
```

## src/main.c
```c
/*
 * Copyright (c) Nanopower Semiconductor AS
 * SPDX-License-Identifier: Apache-2.0
 *
 * samples/sensor_as6212/src/main.c
 * --------------------------------
 * AS6212 temperature sample for the nPZ2100 DK (npz2100dk/nrf52833) on
 * NCS 3.3.4.
 *
 * What it does
 * ------------
 *   - The nPZ2100 polls the AS6212 on the DK on its own (the peripheral
 *     configured in npz2100_regmap.h) and wakes the nRF52833 when the
 *     reading crosses its thresholds, or on the periodic time-out.
 *   - The regmap also carries the peripheral init commands for the nPZ2100
 *     SRAM; npz2100_apply_regmap() writes them on every boot.
 *   - Every peripheral wake prints the last value the nPZ2100 read; for the
 *     AS6212 slot it is converted to degrees Celsius.
 *   - The status LED is on while the nRF52833 is awake.
 *
 * Power architecture
 * ------------------
 * The nPZ2100 controls the nRF52833 power supply via SW_HP. When idle the
 * nPZ2100 cuts power to the nRF52833 completely, so every boot of this
 * application is one wake cycle. The nPZ2100 keeps its registers and SRAM
 * while the nRF52833 is off.
 */

#include <zephyr/kernel.h>
#include <zephyr/device.h>
#include <zephyr/devicetree.h>
#include <zephyr/drivers/gpio.h>
#include <zephyr/logging/log.h>
#include <zephyr/logging/log_ctrl.h>

#include <drivers/npz2100.h>
#include "npz2100_regmap.h"
#include "sample_log_color.h"

LOG_MODULE_REGISTER(app, LOG_LEVEL_INF);

/** Peripheral slot the AS6212 is configured in (peripheral 4: ADDRP4 =
 *  0x48, the AS6212 address on the DK, in npz2100_regmap.h). */
#define AS6212_SLOT          3u

/** Set to 1, with CONFIG_NPZ2100_DUMP=y, to log every nPZ2100 register
 *  before going idle. With the SRAM included it adds about 60 ms of I²C
 *  traffic to every wake. */
#define APP_DUMP_REGISTERS   0

static const struct device *const npz2100 =
	DEVICE_DT_GET(DT_NODELABEL(npz2100));

static const struct gpio_dt_spec led = GPIO_DT_SPEC_GET(DT_ALIAS(led0), gpios);

/* -------------------------------------------------------------------------
 * AS6212 TVAL: 16-bit two's complement, 1 LSB = 1/128 °C. MODP.SWPRREG has
 * already put the two bytes in the right order, so the value is the
 * register exactly as the sensor reports it.
 * ---------------------------------------------------------------------- */
static void as6212_print(uint16_t raw)
{
	/* mdeg = raw * 1000 / 128 = raw * 125 / 16, exact without float. */
	int32_t mdeg = ((int32_t)(int16_t)raw * 125) / 16;
	int32_t a = (mdeg < 0) ? -mdeg : mdeg;

	LOG_INF_HL(SLC_GREEN, "Temperature: %s%d.%03d C (raw 0x%04X)",
		   (mdeg < 0) ? "-" : "", (int)(a / 1000), (int)(a % 1000), raw);
}

static void handle_peripheral_wake(uint8_t slot)
{
	uint16_t raw;
	int ret = npz2100_periph_read_value(npz2100, slot, &raw);

	if (ret != 0) {
		LOG_ERR("Reading peripheral %u failed: %d", slot + 1u, ret);
		return;
	}

	if (slot == AS6212_SLOT) {
		LOG_INF_BANNER("Peripheral 4 wake - AS6212");
		as6212_print(raw);
	} else {
		LOG_INF("Peripheral %u wake: raw 0x%04X", slot + 1u, raw);
	}
}

/* -------------------------------------------------------------------------
 * main
 *
 * Runs once per nRF52833 boot (= once per nPZ2100 wake cycle). Does not
 * contain a loop: npz2100_enter_idle() makes the nPZ2100 cut the power.
 * ---------------------------------------------------------------------- */
int main(void)
{
	int ret;
	npz2100_wake_reason_t reason;

	if (gpio_is_ready_dt(&led)) {
		(void)gpio_pin_configure_dt(&led, GPIO_OUTPUT_ACTIVE);
	}

	LOG_INF_HL(SLC_CYAN, "--- nPZ2100 AS6212 sample boot ---");

	if (!device_is_ready(npz2100)) {
		/* Without the nPZ2100 the nRF52833 cannot go idle; wait for
		 * the nPZ2100 watchdog to power-cycle it. */
		LOG_ERR("nPZ2100 device not ready - waiting for watchdog");
		while (true) {
			k_msleep(1000);
		}
	}

	/* ------------------------------------------------------------------ */
	/* 1. Read wake-up reason.  MUST be the first nPZ2100 operation.      */
	/*    Also kicks the nPZ2100 watchdog (reading STA1/STA2).            */
	/* ------------------------------------------------------------------ */
	ret = npz2100_boot_status(npz2100, &reason);
	if (ret != 0) {
		LOG_ERR("boot_status failed: %d - cannot determine wake reason", ret);
		reason = (npz2100_wake_reason_t){ 0 };
	}

	/* ------------------------------------------------------------------ */
	/* 2. Sync shadow from device (no I²C unless CONFIG_NPZ2100_SHADOW).  */
	/* ------------------------------------------------------------------ */
	ret = npz2100_readback(npz2100);
	if (ret != 0) {
		LOG_ERR("readback failed: %d", ret);
	}

	/* ------------------------------------------------------------------ */
	/* 3. Apply the configuration, including the SRAM init commands at    */
	/*    the end of the regmap.  Do not also write the same SRAM bytes   */
	/*    with npz2100_sram_write().                                      */
	/* ------------------------------------------------------------------ */
	ret = npz2100_apply_regmap(npz2100, npz2100_regmap, sizeof(npz2100_regmap));
	if (ret != 0) {
		LOG_ERR("apply_regmap failed: %d", ret);
	}

	/* ------------------------------------------------------------------ */
	/* 4. Handle the wake reason.                                          */
	/* ------------------------------------------------------------------ */
	for (uint8_t slot = 0u; slot < ARRAY_SIZE(reason.periph); slot++) {
		if (reason.periph[slot]) {
			handle_peripheral_wake(slot);
		}
	}
	if (reason.timeout) {
		LOG_INF_HL(SLC_BLUE, "Global time-out wake");
	}
	if (reason.alarm) {
		LOG_INF_HL(SLC_BLUE, "Global time counter alarm wake");
	}

#if APP_DUMP_REGISTERS && defined(CONFIG_NPZ2100_DUMP)
	(void)npz2100_dump_registers(npz2100, NPZ2100_DUMP_SRAM);
#endif

	/* ------------------------------------------------------------------ */
	/* 5. Re-enter idle.  The nPZ2100 cuts nRF52833 power.                */
	/*    LOG_PANIC() flushes the deferred log buffer first so no output  */
	/*    is lost when power is cut.                                       */
	/* ------------------------------------------------------------------ */
	LOG_INF_HL(SLC_GRAY, "Returning to idle");
	LOG_PANIC();

	ret = npz2100_enter_idle(npz2100);

	/* Reaching here means the I²C write to IDLE_RST failed. The nPZ2100
	 * watchdog power-cycles the nRF52833 after its time-out. */
	LOG_ERR("enter_idle failed: %d - waiting for watchdog", ret);
	while (true) {
		k_msleep(1000);
	}

	return 0; /* unreachable */
}
```

## src/npz2100_regmap.h
```c
#ifndef __NPZ2100_REGMAP
#define __NPZ2100_REGMAP

// nPZ2100 Register Map
//
// Generated by the nPZ2100 configuration tool for the nPZ2100 DK.
// Peripheral 4 (P_BANK 3, ADDRP4 = 0x48) is the AS6212 on the DK; its
// window is THRUNP4 = 0x0898 (17.2 C) to THROVP4 = 0x0DAC (27.3 C).
// The last segment holds the peripheral init commands for SRAM 0x00-0x06;
// npz2100_apply_regmap() writes it on every boot.

const unsigned char npz2100_regmap[] = {
  // ---- Global configuration registers ----
  10,         // Length
  0x05,       // Start address (IOCFG1 register)
  0x20, // IOCFG1 = 0x20
  0x5A, // IOCFG2 = 0x5A
  0xFF, // IOCFG3 = 0xFF
  0x00, // IOCFG4 = 0x00
  0x1C, // IOCFG5 = 0x1C (I2C_PUP_EN=1, I2C_PUP_AUTO=1, SPI_AUTO=1, PSW_SR=0)
  0x0C, // SYSCFG1 = 0x0C
  0x00, // SYSCFG2 = 0x00
  0xC0, 0x03, // (TOUT_L/TOUT_H)

  // ---- Peripheral 3 ---- 
  16,         // Length
  0x1F,       // Start address (P_BANK register)
  0x02,       // (P_BANK index)
  0x01, // CFGP3 = 0x01
  0x2A, // IOP3 = 0x2A
  0x02, // MODP3 = 0x02
  0x30, 0x00, // (PERP_L3/PERP_H3)
  0x02, // NCMDP3 = 0x02
  0x01, // ADDRP3 = 0x01
  0x00, // RREGP3 = 0x00
  0xE8, 0x03, // (THROVP_L3/THROVP_H3)
  0x18, 0xFC, // (THRUNP_L3/THRUNP_H3)
  0x9C, // TWTP3 = 0x9C
  0x85, // TCFGP3 = 0x85

  // ---- Peripheral 4 ---- 
  16,         // Length
  0x1F,       // Start address (P_BANK register)
  0x03,       // (P_BANK index)
  0x01, // CFGP4 = 0x01
  0x3F, // IOP4 = 0x3F
  0x2A, // MODP4 = 0x2A
  0xF0, 0x00, // (PERP_L4/PERP_H4)
  0x02, // NCMDP4 = 0x02
  0x48, // ADDRP4 = 0x48
  0x00, // RREGP4 = 0x00
  0xAC, 0x0D, // (THROVP_L4/THROVP_H4)
  0x98, 0x08, // (THRUNP_L4/THRUNP_H4)
  0x6D, // TWTP4 = 0x6D
  0x05, // TCFGP4 = 0x05

  // ---- SRAM registers ---- 
  9,          // Length
  0x7F,       // Start address (SRAM_BANK)
  0x00,       // SRAM bank 0
  0x20, 0x10, 0x29, 0x01, 0x82, 0x02, 0xA0, // SRAM address: 0x00-06
};

#endif // __NPZ2100_REGMAP
```
